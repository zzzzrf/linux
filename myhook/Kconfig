## myhook/Kconfig
```kconfig
menuconfig MY_HOOK
	bool "My Hook Debug Support"
	help
		My Hook Debug Support

if MY_HOOK

config MY_HOOK_NF_DEBUG
    bool "netfilter debug hook"
    default n
    help
		netfilter debug hook

config MY_HOOK_CT_DEBUG
    bool "conntrack debug"
	select MY_HOOK_NF_DEBUG
    default n
    help
		conntrack debug hook

endif
```
